## target/linux/ar79/files/arch/mips/ar79/Kconfig
```kconfig
if AR79

menu "Atheros AR7XXX/AR9XXX machine selection"

config AR79_MACH_WAFI_R1001
	bool "Atheros 9341 : WAWIFI wafi_r1001 reference board"
	select SOC_AR934X
	select AR79_DEV_AP9X_PCI if PCI
	select AR79_DEV_ETH
	select AR79_DEV_GPIO_BUTTONS
	select AR79_DEV_LEDS_GPIO
	select AR79_DEV_M25P80
	select AR79_DEV_NFC
	select AR79_DEV_USB
	#select AR79_DEV_WMAC
	help
	  Say 'Y' here if you want your kernel to support the
	  Atheros 9341 : WAWIFI wafi_r1001 reference board.

endmenu

config SOC_AR71XX
	select USB_ARCH_HAS_EHCI
	select USB_ARCH_HAS_OHCI
	select HW_HAS_PCI
	def_bool n

config SOC_AR724X
	select USB_ARCH_HAS_EHCI
	select USB_ARCH_HAS_OHCI
	select HW_HAS_PCI
	select PCI_AR724X if PCI
	def_bool n

config SOC_AR913X
	select USB_ARCH_HAS_EHCI
	def_bool n

config SOC_AR933X
	select USB_ARCH_HAS_EHCI
	def_bool n

config SOC_AR934X
	select USB_ARCH_HAS_EHCI
	select HW_HAS_PCI
	select PCI_AR724X if PCI
	def_bool n

config SOC_QCA955X
	select USB_ARCH_HAS_EHCI
	select HW_HAS_PCI
	select PCI_AR724X if PCI
	def_bool n

config AR79_DEV_AP9X_PCI
	select AR79_PCI_ATH9K_FIXUP
	def_bool n

config AR79_DEV_DSA
	def_bool n

config AR79_DEV_ETH
	def_bool n

config AR79_DEV_M25P80
	select AR79_DEV_SPI
	def_bool n

config AR79_DEV_DSA
	def_bool n

config AR79_DEV_ETH
	def_bool n

config AR79_DEV_GPIO_BUTTONS
	def_bool n

config AR79_DEV_LEDS_GPIO
	def_bool n

config AR79_DEV_NFC
	depends on (SOC_AR934X)
	def_bool n

config AR79_DEV_SPI
	def_bool n

config AR79_DEV_USB
	def_bool n

config AR79_DEV_WMAC
	depends on (SOC_AR913X || SOC_AR933X || SOC_AR934X || SOC_QCA955X)
	def_bool n

config AR79_NVRAM
	def_bool n

config AR79_PCI_ATH9K_FIXUP
	def_bool n

config AR79_ROUTERBOOT
	def_bool n

config PCI_AR724X
	def_bool n

endif
```

## target/linux/ramips/files/arch/mips/ralink/Kconfig
```kconfig
if RAMIPS 

choice
	prompt "Ralink SoC selection"
	default SOC_MT7620
	help
	  Select Ralink MIPS SoC type.

	config RALINK_MT7620
		bool "MT7620"
		select SOC_MT7620

endchoice

source "arch/mips/ralink/mt7620/Kconfig"

config SOC_MT7620
	bool
	select CEVT_R4K
	select CSRC_R4K
	select DMA_NONCOHERENT
	select IRQ_CPU
	select ARCH_REQUIRE_GPIOLIB
	select SYS_HAS_CPU_MIPS32_R1
	select SYS_HAS_CPU_MIPS32_R2
	select SYS_SUPPORTS_32BIT_KERNEL
	select SYS_SUPPORTS_LITTLE_ENDIAN
	select SYS_HAS_EARLY_PRINTK
	select MIPS_MACHINE
	select USB_ARCH_HAS_HCD
	select USB_ARCH_HAS_OHCI
	select USB_ARCH_HAS_EHCI
	select HAVE_CLK

config RALINK_DEV_GPIO_BUTTONS
	def_bool n

config RALINK_DEV_GPIO_LEDS
	def_bool n

endif
```

## target/linux/ramips/files/arch/mips/ralink/mt7620/Kconfig
```kconfig
if RALINK_MT7620

menu "Ralink MT7620 machine selection"

config MT7620_MACH_WIFI_ROUTER
	bool "Demo WifiRouter support"
	select RALINK_DEV_GPIO_BUTTONS
	select RALINK_DEV_GPIO_LEDS

config MT7620_MACH_WIFI_ROUTER_POE
	bool "Demo WifiRouter PoE support"
	select RALINK_DEV_GPIO_BUTTONS
	select RALINK_DEV_GPIO_LEDS

config MT7620_MACH_WIFI_ROUTER_WALLPOE
	bool "Demo WifiRouter PoE On Wall support"
	select RALINK_DEV_GPIO_BUTTONS
	select RALINK_DEV_GPIO_LEDS
endmenu

endif
```

## target/linux/ramips/files/drivers/net/ramips/Kconfig
```kconfig
config NET_RAMIPS
       tristate "Ralink MT7620 ethernet driver"
       depends on RAMIPS 
       select SWCONFIG if SOC_MT7620
       help
         This driver supports the etehrnet mac inside the ralink wisocs

if NET_RAMIPS

config NET_ESW_EXTERN_PHY_BASE
	int "configuration the phy4 ,phy5 or both base address ID (0-31)"
	range 0 31
	default 4

config NET_RAMIPS_DEBUG
       bool "Enable debug messages in the Ralink ethernet driver"

config NET_RAMIPS_DEBUG_FS
	bool "Enable debugfs support for the Ralink ethernet driver"
	depends on DEBUG_FS

endif
```
